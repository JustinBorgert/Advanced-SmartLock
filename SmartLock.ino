/*
 * Typical pin layout used (this is what I used since its used in examples anyways):
 * -----------------------------------------------------------------------------------------
 *             MFRC522      Arduino       Arduino   Arduino    Arduino          Arduino
 *             Reader/PCD   Uno/101       Mega      Nano v3    Leonardo/Micro   Pro Micro
 * Signal      Pin          Pin           Pin       Pin        Pin              Pin
 * -----------------------------------------------------------------------------------------
 * RST/Reset   RST          9             5         D9         RESET/ICSP-5     RST
 * SPI SS      SDA(SS)      10            53        D10        10               10
 * SPI MOSI    MOSI         11 / ICSP-4   51        D11        ICSP-4           16
 * SPI MISO    MISO         12 / ICSP-1   50        D12        ICSP-1           14
 * SPI SCK     SCK          13 / ICSP-3   52        D13        ICSP-3           15
 */
////////////////////////////////////////////////////////////////////////////////////////////////////////////////////////////////////////////////////////////////////////////////////////////////////////////////////////////////////////////////////////////////////////////////////////////////////////////////
////////////////////////////////////////////////////////////////////////////////////////////////////////////////////////////////////////////////////////////////////////////////////////////////////////////////////////////////////////////////////////////////////////////////////////////////////////////////
///////////////////////////////////////////////////////////////////////////////////////////////////////////////////////////////////////////Library/Values/Define/etc.////////////////////////////////////////////////////////////////////////////////////////////////////////////////////////////////////////////////////////////
////////////////////////////////////////////////////////////////////////////////////////////////////////////////////////////////////////////////////////////////////////////////////////////////////////////////////////////////////////////////////////////////////////////////////////////////////////////////
////////////////////////////////////////////////////////////////////////////////////////////////////////////////////////////////////////////////////////////////////////////////////////////////////////////////////////////////////////////////////////////////////////////////////////////////////////////////
#include <Servo.h>
 
#include <SPI.h>
#include <MFRC522.h>

#include <Wire.h>
#include <LiquidCrystal_I2C.h>
 
#define RST_PIN   9                           // SPI Reset Pin
#define SS_PIN    10                          // SPI Slave Select Pin
 
MFRC522 mfrc522(SS_PIN, RST_PIN);   
 
byte CARD_uid[] = {0x55, 0xC5, 0xB3, 0xAB};
byte TAG_uid[] = {0xD0, 0x10, 0xBC, 0x4F};

int Buzzer = 8;                               // Pin des Buzzers

LiquidCrystal_I2C lcd(0x3F, 16, 2);           // LC-Display config (I used and I2C Display since it's way easier to connect with the Arduino)

                                              // States we are later using for our RFID Reader

int CARD_check = false;                       
int TAG_check = false;
int NO_check = false;

int PIR = 7;                                  // Pin of the PIR (Motion sensor)

#define trigPin 2                             // HC-SR04 TriggerPIN
#define echoPin 3                             // HC-SR04 EchoPIN

                                              // Creating two variables which makes the use of the Ultra-Sonic-Sensor easier

long duration;                                
int distance;

Servo Servo;                                  // Setup of the Servo

////////////////////////////////////////////////////////////////////////////////////////////////////////////////////////////////////////////////////////////////////////////////////////////////////////////////////////////////////////////////////////////////////////////////////////////////////////////////
////////////////////////////////////////////////////////////////////////////////////////////////////////////////////////////////////////////////////////////////////////////////////////////////////////////////////////////////////////////////////////////////////////////////////////////////////////////////
///////////////////////////////////////////////////////////////////////////////////////////////////////////////////////////////////////////VOID-SETUP///////////////////////////////////////////////////////////////////////////////////////////////////////////////////////////////////////////////////////////
////////////////////////////////////////////////////////////////////////////////////////////////////////////////////////////////////////////////////////////////////////////////////////////////////////////////////////////////////////////////////////////////////////////////////////////////////////////////
////////////////////////////////////////////////////////////////////////////////////////////////////////////////////////////////////////////////////////////////////////////////////////////////////////////////////////////////////////////////////////////////////////////////////////////////////////////////
void setup() 
{
 // These functions will only be activated once at the start
  
  Serial.begin(9600);                 // Serial Communication with the computer will initialize 
  SPI.begin();                        // initialize SPI Kommunikation
  mfrc522.PCD_Init();                 // initialize MFRC522 Readmodule

  pinMode(Buzzer, OUTPUT);            // Setup the Buzzer as an OUTPUT 

  pinMode(trigPin, OUTPUT);           // Setup the INPUT and OUTPUT of the UltraSonic-Sensor
  pinMode(echoPin, INPUT);            

  pinMode(PIR, INPUT);                // Setup the PIR Sensor as an INPUT

  lcd.begin();                        // Starts the LC-Display 
  lcd.clear();                        // Clears the LC-Display (Sometimes Text could still be Displayed incorrectly otherwise)

  Servo.attach(4);                    // The Servo is controlled by the PIN 5
   
}
 

////////////////////////////////////////////////////////////////////////////////////////////////////////////////////////////////////////////////////////////////////////////////////////////////////////////////////////////////////////////////////////////////////////////////////////////////////////////////
////////////////////////////////////////////////////////////////////////////////////////////////////////////////////////////////////////////////////////////////////////////////////////////////////////////////////////////////////////////////////////////////////////////////////////////////////////////////
///////////////////////////////////////////////////////////////////////////////////////////////////////////////////////////////////////////VOID-LOOP////////////////////////////////////////////////////////////////////////////////////////////////////////////////////////////////////////////////////////////
////////////////////////////////////////////////////////////////////////////////////////////////////////////////////////////////////////////////////////////////////////////////////////////////////////////////////////////////////////////////////////////////////////////////////////////////////////////////
////////////////////////////////////////////////////////////////////////////////////////////////////////////////////////////////////////////////////////////////////////////////////////////////////////////////////////////////////////////////////////////////////////////////////////////////////////////////
void loop() 
{
    ////////////////////////////////////////////////////////////////////////////////////////////////////////////////////////////////////////IDLE///////////////////////////////////////////////////////////////////////////////////////////////////////////////////////////////////////////////////////////


    Servo.write(90); //Servo goes to closed state

    // Here we setup the start of the LC-Display
    
    lcd.clear();
    lcd.noBacklight();   

    // Here we combine the PIR-Sensor with the Display to only activate it when the PIR-Sensor does detect something. Then the Display switches to the Nametag of the householders and will go off when no motions are detected (to safe energy)

    if(digitalRead(PIR) == HIGH)
    {
      lcd.backlight();
      lcd.setCursor(4,0);
      lcd.print("Welcome!");
      lcd.setCursor(1,1);
      lcd.print("Family Borgert");
    }
    else
    {
      lcd.clear();
      lcd.noBacklight();
    }
    ////////////////////////////////////////////////////////////////////////////////////////////////////////////////////////////////////////CARD/TAG-READER///////////////////////////////////////////////////////////////////////////////////////////////////////////////////////////////////////////////////////////
  
    // If only one card can be found and only one can be read, the context will be excuted from IF
    // PICC = proximity integrated circuit card = RFID-TAG and RFID-CARD
    if (mfrc522.PICC_IsNewCardPresent() && mfrc522.PICC_ReadCardSerial() ) 
    {
      Serial.print("Gelesene UID:");
      for (byte i = 0; i < mfrc522.uid.size; i++) 
        {
          Serial.print(mfrc522.uid.uidByte[i] < 0x10 ? " 0" : " ");
          Serial.print(mfrc522.uid.uidByte[i], HEX);
        } 
      Serial.println();
 
      // UID compared with the CARD_uid
      CARD_check = true;
      for (int j=0; j<4; j++) 
        {
          if (mfrc522.uid.uidByte[j] != CARD_uid[j]) 
          {
            CARD_check = false;
          }
        }
 
      // UID compared with the TAG_uid
      TAG_check = true;
      for (int j=0; j<4; j++) 
      {
        if (mfrc522.uid.uidByte[j] != TAG_uid[j]) 
        {
          TAG_check = false;
        }
      }
 

      //When The RFID-Card is found then these Series of events will happen
      if (CARD_check) 
      {
        lcd.backlight();
        lcd.clear();
        lcd.setCursor(1,0);
        lcd.print("Acces Granted!");
        lcd.setCursor(1,1);
        lcd.print ("Welcome Justin");


        tone(8, 2700);
        delay(100);
        noTone(8);
        delay(25);
        tone(8, 2700); 
        delay(100);
        noTone(8);
        Servo.write(0);

      }
 
      //When The RFID-Tag is found then these Series of events will happen
      if (TAG_check) 
      { 
        lcd.backlight();
        lcd.clear();
        lcd.setCursor(2,0);
        lcd.print("Acces Denied!");
        lcd.setCursor(2,1);
        lcd.print ("Wrong Card!");


        tone(8, 200);
        delay(1000);
        noTone(8);
      }

      // Sets the reading card in sleep mode, to search for other card.
    
      mfrc522.PICC_HaltA();
      delay(10000);

      // Everything will send back to the orignal state to prevent bugs to occure and to let the door close again
      digitalWrite(Buzzer, LOW);
      lcd.clear();
      lcd.noBacklight();
      Servo.write(90);

    }
  
    ////////////////////////////////////////////////////////////////////////////////////////////////////////////////////////////////////////ALARM///////////////////////////////////////////////////////////////////////////////////////////////////////////////////////////////////////////////////////////

    // Clear the trigPin by setting it LOW:
    digitalWrite(trigPin, LOW);
    delayMicroseconds(5);
    // Trigger the sensor by setting the trigPin high for 10 microseconds:
    digitalWrite(trigPin, HIGH);
    delayMicroseconds(10);
    digitalWrite(trigPin, LOW);
    // Read the echoPin, pulseIn() returns the duration (length of the pulse) in microseconds:
    duration = pulseIn(echoPin, HIGH);
    // Calculate the distance:
    distance = duration * 0.034 / 2;

    // combine all the states from the RFID to one
    if (!CARD_check || !TAG_check)
    {
      NO_check = true;
    }

    //Setups the alarm which will go 10 seconds and then can be deactivated while we do have an constant alarm tone going (This can be changed by preferences)
    if (distance >= 5 && NO_check)
    {
      for(int i = 1; i<=100; i++)
      {
        tone(8, 2700);
        delay(100);
        tone(8, 200);
        delay(100);
      }
      delay(1000);
    }
  
}
